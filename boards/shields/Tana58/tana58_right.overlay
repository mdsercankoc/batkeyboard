#include "tana58.dtsi"

&default_transform { 
    // Sağ modülün matriste 6 sütun sağa kaydırılmasını sağlayan ZMK kuralı
    col-offset = <6>;
};

&kscan0 {
    col-gpios
        = <&gpio0 24 GPIO_ACTIVE_HIGH> 
        , <&gpio1 0 GPIO_ACTIVE_HIGH>  
        , <&gpio0 11 GPIO_ACTIVE_HIGH> 
        , <&gpio1 4 GPIO_ACTIVE_HIGH>  
        , <&gpio0 31 GPIO_ACTIVE_HIGH> 
        , <&gpio0 29 GPIO_ACTIVE_HIGH> 
        ;
};
